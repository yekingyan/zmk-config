## boards/shields/bgkeeb/Kconfig.defconfig
```kconfig
if SHIELD_BGKEEB_LEFT

config ZMK_KEYBOARD_NAME
    default "BGKeeB"

config ZMK_SPLIT_ROLE_CENTRAL
    default y

endif

if SHIELD_BGKEEB_LEFT || SHIELD_BGKEEB_RIGHT
config ZMK_SPLIT
    default y
endif
```

## boards/shields/cradio_dongle/Kconfig.defconfig
```kconfig
if SHIELD_CRADIO_DONGLE

config ZMK_KEYBOARD_NAME
    default "Dolphin Dongle"

config ZMK_SPLIT_ROLE_CENTRAL
    def_bool y

endif
```

## boards/shields/cradio_dongle/Kconfig.shield
```kconfig
# Copyright (c) 2026 The ZMK Contributors
# SPDX-License-Identifier: MIT

config SHIELD_CRADIO_DONGLE
    def_bool $(shields_list_contains,cradio_dongle)
```

## boards/shields/dolphin1/Kconfig.defconfig
```kconfig
# Copyright (c) 2024 The ZMK Contributors
# SPDX-License-Identifier: MIT

if SHIELD_DOLPHIN1_LEFT

config ZMK_KEYBOARD_NAME
    default "Dolphin1"

config ZMK_SPLIT_ROLE_CENTRAL
    default y

endif

if SHIELD_DOLPHIN1_LEFT || SHIELD_DOLPHIN1_RIGHT

config ZMK_SPLIT
    default y

endif
```

## boards/shields/dolphin1/Kconfig.shield
```kconfig
# Copyright (c) 2024 The ZMK Contributors
# SPDX-License-Identifier: MIT

config SHIELD_DOLPHIN1_LEFT
    def_bool $(shields_list_contains,dolphin1_left)

config SHIELD_DOLPHIN1_RIGHT
    def_bool $(shields_list_contains,dolphin1_right)
```

## boards/shields/dolphin36/Kconfig.defconfig
```kconfig
# Copyright (c) 2024 The ZMK Contributors
# SPDX-License-Identifier: MIT

if SHIELD_DOLPHIN36_LEFT

config ZMK_KEYBOARD_NAME
    default "Dolphin36"

config ZMK_SPLIT_ROLE_CENTRAL
    default y

endif

if SHIELD_DOLPHIN36_LEFT || SHIELD_DOLPHIN36_RIGHT

config ZMK_SPLIT
    default y

endif
```

## boards/shields/dolphin36/Kconfig.shield
```kconfig
# Copyright (c) 2024 The ZMK Contributors
# SPDX-License-Identifier: MIT

config SHIELD_DOLPHIN36_LEFT
    def_bool $(shields_list_contains,dolphin36_left)

config SHIELD_DOLPHIN36_RIGHT
    def_bool $(shields_list_contains,dolphin36_right)
```
