## boards/shields/bgkeeb/Kconfig.shield
```kconfig
config SHIELD_BGKEEB_LEFT
    def_bool $(shields_list_contains,bgkeeb_left)

config SHIELD_BGKEEB_RIGHT
    def_bool $(shields_list_contains,bgkeeb_right)
```
