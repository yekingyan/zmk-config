/*
 * cradio_left.overlay
 *
 * 覆盖官方 cradio 的引脚映射，适配自制 PCB（SW 编号与网络标号 1:1 映射）。
 * 与原版区别：索引 0 和索引 14 的引脚互换（pin 6 ↔ pin 7）。
 *
 * 原版：索引 0 = pin 7 (Q)，索引 14 = pin 6 (B)
 * 本版：索引 0 = pin 6 (Q)，索引 14 = pin 7 (B)
 */

&kscan0 {
    compatible = "zmk,kscan-gpio-direct";
    input-gpios
        // 第一排 (Top Row: Q W E R T)
        = <&pro_micro  6 (GPIO_ACTIVE_LOW | GPIO_PULL_UP)> // SW1  → Q (原版是 pin 7)
        , <&pro_micro 18 (GPIO_ACTIVE_LOW | GPIO_PULL_UP)> // SW2  → W
        , <&pro_micro 19 (GPIO_ACTIVE_LOW | GPIO_PULL_UP)> // SW3  → E
        , <&pro_micro 20 (GPIO_ACTIVE_LOW | GPIO_PULL_UP)> // SW4  → R
        , <&pro_micro 21 (GPIO_ACTIVE_LOW | GPIO_PULL_UP)> // SW5  → T

        // 第二排 (Middle Row: A S D F G)
        , <&pro_micro 15 (GPIO_ACTIVE_LOW | GPIO_PULL_UP)> // SW6  → A
        , <&pro_micro 14 (GPIO_ACTIVE_LOW | GPIO_PULL_UP)> // SW7  → S
        , <&pro_micro 16 (GPIO_ACTIVE_LOW | GPIO_PULL_UP)> // SW8  → D
        , <&pro_micro 10 (GPIO_ACTIVE_LOW | GPIO_PULL_UP)> // SW9  → F
        , <&pro_micro  1 (GPIO_ACTIVE_LOW | GPIO_PULL_UP)> // SW10 → G

        // 第三排 (Bottom Row: Z X C V B)
        , <&pro_micro  2 (GPIO_ACTIVE_LOW | GPIO_PULL_UP)> // SW11 → Z
        , <&pro_micro  3 (GPIO_ACTIVE_LOW | GPIO_PULL_UP)> // SW12 → X
        , <&pro_micro  4 (GPIO_ACTIVE_LOW | GPIO_PULL_UP)> // SW13 → C
        , <&pro_micro  5 (GPIO_ACTIVE_LOW | GPIO_PULL_UP)> // SW14 → V
        , <&pro_micro  7 (GPIO_ACTIVE_LOW | GPIO_PULL_UP)> // SW15 → B (原版是 pin 6)

        // 拇指键簇 (Thumb Cluster)
        , <&pro_micro  8 (GPIO_ACTIVE_LOW | GPIO_PULL_UP)> // 拇指键 1 (靠内)
        , <&pro_micro  9 (GPIO_ACTIVE_LOW | GPIO_PULL_UP)> // 拇指键 2 (靠外)
        ;
};
